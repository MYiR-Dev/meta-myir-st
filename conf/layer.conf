## conf/layer.conf
```bitbake
# We have a conf and classes directory, add to BBPATH
BBPATH .= ":${LAYERDIR}"

# We have a recipes-* directories, add to BBFILES
BBFILES += "${LAYERDIR}/recipes-*/*/*.bb \
	${LAYERDIR}/recipes-*/*/*.bbappend"

BBFILE_COLLECTIONS += "stm-myir-st"
BBFILE_PATTERN_stm-myir-st := "^${LAYERDIR}/"
BBFILE_PRIORITY_stm-myir-st = "6"

EULA_FILE_ST:myir = "${LAYERDIR}/conf/eula/${MACHINE}"
EULA_FILE_ST_MD5SUM:myir = "8b505090fb679839cefbcc784afe8ce9"

# Set a variable to get the STM32MP BSP location
STM32MP_BASE = "${LAYERDIR}"

# This should only be incremented on significant changes that will
# cause compatibility issues with other layers
LAYERVERSION_stm-myir-st = "1"
LAYERSERIES_COMPAT_stm-myir-st = "kirkstone"

# for optee-os-stm32mp dependency
LAYERDEPENDS_stm-myir-st = "core openembedded-layer meta-python"

# OpenSTLinux compatibility version
ST_OSTL_COMPATIBILITY_VERSION_stm-myir-st = "4.0 4.1"
```

## conf/machine/include/myir-machine-providers-stm32mp.inc
```bitbake
# =========================================================================
# Kernel
# =========================================================================
PREFERRED_PROVIDER_virtual/kernel = "linux-myir"

# =========================================================================
# u-boot
# =========================================================================
PREFERRED_PROVIDER_virtual/bootloader = "u-boot-myir"
PREFERRED_PROVIDER_u-boot = "u-boot-myir"

# =========================================================================
# trusted-firmware-a
# =========================================================================
PREFERRED_PROVIDER_virtual/trusted-firmware-a = "tf-a-myir"

# =========================================================================
# optee-os
# =========================================================================
PREFERRED_PROVIDER_virtual/optee-os = "optee-os-myir"
```

## conf/machine/myd-yf13x-emmc.conf
```bitbake
#@TYPE: Machine
#@NAME: myd-yf13x-emmc
#@DESCRIPTION: MYD-YF13X with emmc flash 
#@NEEDED_BSPLAYERS: layers/meta-openembedded/meta-oe layers/meta-openembedded/meta-python

include conf/machine/include/myir-machine-common-stm32mp.inc
include conf/machine/include/myir-machine-providers-stm32mp.inc

# Define specific familly common machine name
MACHINEOVERRIDES .= "myir:stm32mp1common:stm32mp13common"

# =========================================================================
# Chip architecture
# =========================================================================
DEFAULTTUNE = "cortexa7thf-neon-vfpv4"
include conf/machine/include/arm/armv7a/tune-cortexa7.inc

# =========================================================================
# boot scheme
# =========================================================================
BOOTSCHEME_LABELS += "optee"
UBOOT_CONFIG:append ="myiremmc_stm32mp13"
# =========================================================================
# boot device
# =========================================================================
# Define the boot device supported
BOOTDEVICE_LABELS += "emmc"
#BOOTDEVICE_LABELS += "nand-4-256"
#BOOTDEVICE_LABELS += "nor-sdcard"
BOOTDEVICE_LABELS += "sdcard"

# for default compile
UBOOT_EXTLINUX_DEFAULT_LABEL = "myb-stm32mp135x-512m"

UBOOT_EXTLINUX_LABELS:target-emmc += "myb-stm32mp135x-512m-hdmi"
#MYIR_DT_FILES_13x_EMMC_EXT = "myb-stm32mp135x-512m-hdmi"
# =========================================================================
# Machine settings
# =========================================================================
# Define list of devicetree per board
MYIR_DT_FILES_13x += "myb-stm32mp135x-512m "


# =========================================================================
# Machine features
# =========================================================================
MACHINE_FEATURES += "splashscreen"
MACHINE_FEATURES += "watchdog"
MACHINE_FEATURES += "bluetooth"
MACHINE_FEATURES += "wifi"
MACHINE_FEATURES += "nosmp"
MACHINE_FEATURES += "usbg0"

# Bluetooth
BLUETOOTH_LIST += "linux-firmware-bluetooth-bcm4343"
# Wifi
WIFI_LIST += "linux-firmware-bcm43430"

# =========================================================================
# Kernel
# =========================================================================

# Define the devicetree for Linux A7 examples
LINUX_A7_EXAMPLES_DT += "myb-stm32mp135x-512m-hdmi"

# =========================================================================
# WIC for sdcard raw image
# =========================================================================
WIC_CREATE_EXTRA_ARGS = "--no-fstab-update"
WKS_FILE_DEPENDS ?= " \
    virtual/bootloader \
    virtual/trusted-firmware-a \
    ${@bb.utils.contains('BOOTSCHEME_LABELS', 'optee', 'virtual/optee-os', '', d)} \
    st-image-bootfs \
    ${@bb.utils.contains('ST_VENDORFS','1','st-image-vendorfs', '', d)} \
    st-image-userfs \
"
OPTEE_WIC_FILE = "${@bb.utils.contains('ST_VENDORFS','1','sdcard-stm32mp135f-dk-optee-vendorfs-1GB.wks.in','sdcard-stm32mp135f-dk-optee-1GB.wks.in',d)}"

# for generated a WIC file, please uncomment the 2 following lines or add them to local.conf
#WKS_IMAGE_FSTYPES += "wic wic.bz2 wic.bmap"
#WKS_FILE += "${OPTEE_WIC_FILE}"

DISTRO_FEATURES:remove = "pulseaudio"

# Set time zone
DEFAULT_TIMEZONE = "Asia/Shanghai"

IMAGE_ROOTFS_MAXSIZE = "885796"
```

## conf/machine/myd-yf13x-nand.conf
```bitbake
#@TYPE: Machine
#@NAME: myd-yf13x-nand
#@DESCRIPTION: MYD-YF13X with nand flash 
#@NEEDED_BSPLAYERS: layers/meta-openembedded/meta-oe layers/meta-openembedded/meta-python

include conf/machine/include/myir-machine-common-stm32mp.inc
include conf/machine/include/myir-machine-providers-stm32mp.inc

# Define specific familly common machine name
MACHINEOVERRIDES .= "stm32mp1common:stm32mp13common"

# =========================================================================
# Chip architecture
# =========================================================================
DEFAULTTUNE = "cortexa7thf-neon-vfpv4"
include conf/machine/include/arm/armv7a/tune-cortexa7.inc

# =========================================================================
# boot scheme
# =========================================================================
BOOTSCHEME_LABELS += "optee"
UBOOT_CONFIG:append ="myirnand_stm32mp13"
# =========================================================================
# boot device
# =========================================================================
# Define the boot device supported
#BOOTDEVICE_LABELS += "emmc"
#BOOTDEVICE_LABELS += "nand-4-256"
#BOOTDEVICE_LABELS += "nand-256-256"
#BOOTDEVICE_LABELS += "nor-sdcard"
BOOTDEVICE_LABELS += "spinand-256-256"
BOOTDEVICE_LABELS += "sdcard"

# for default compile
UBOOT_EXTLINUX_DEFAULT_LABEL = "myb-stm32mp135x-256m"

UBOOT_EXTLINUX_LABELS:target-nand += "myb-stm32mp135x-256m-hdmi"
UBOOT_EXTLINUX_LABELS:target-sdcard += "myb-stm32mp135x-256m-hdmi"
# =========================================================================
# Machine settings
# =========================================================================
# Define list of devicetree per board
MYIR_DT_FILES_13x += "myb-stm32mp135x-256m "


# =========================================================================
# Machine features
# =========================================================================
MACHINE_FEATURES += "splashscreen"
MACHINE_FEATURES += "watchdog"
MACHINE_FEATURES += "bluetooth"
MACHINE_FEATURES += "wifi"
MACHINE_FEATURES += "nosmp"
MACHINE_FEATURES += "usbg0"

# Bluetooth
BLUETOOTH_LIST += "linux-firmware-bluetooth-bcm4343"
# Wifi
WIFI_LIST += "linux-firmware-bcm43430"

# =========================================================================
# Kernel
# =========================================================================

# Define the devicetree for Linux A7 examples
LINUX_A7_EXAMPLES_DT += "myb-stm32mp135x-256m-hdmi"

# =========================================================================
# WIC for sdcard raw image
# =========================================================================
WIC_CREATE_EXTRA_ARGS = "--no-fstab-update"
WKS_FILE_DEPENDS ?= " \
    virtual/bootloader \
    virtual/trusted-firmware-a \
    ${@bb.utils.contains('BOOTSCHEME_LABELS', 'optee', 'virtual/optee-os', '', d)} \
    st-image-bootfs \
    ${@bb.utils.contains('ST_VENDORFS','1','st-image-vendorfs', '', d)} \
    st-image-userfs \
"
OPTEE_WIC_FILE = "${@bb.utils.contains('ST_VENDORFS','1','sdcard-stm32mp135f-dk-optee-vendorfs-1GB.wks.in','sdcard-stm32mp135f-dk-optee-1GB.wks.in',d)}"

# for generated a WIC file, please uncomment the 2 following lines or add them to local.conf
#WKS_IMAGE_FSTYPES += "wic wic.bz2 wic.bmap"
#WKS_FILE += "${OPTEE_WIC_FILE}"

ST_VENDORFS = "0"
ST_USERFS   = "0"
DISTRO_FEATURES:remove = "pulseaudio"

# Set time zone
DEFAULT_TIMEZONE = "Asia/Shanghai"

UBOOT_MTDPART_SPINAND_BOOT = "${@','.join(['%sk(%s)' % (align_size(d, 'SPINAND', l.split(',')[2], l.split(',')[4]), l.split(',')[1]) for l in d.getVarFlag('PARTITIONS_BOOTLOADER_CONFIG', 'spinand-256-256').split()])}"
```

## conf/machine/myir.conf
```bitbake
#@TYPE: Machine
#@NAME: myir
#@DESCRIPTION: Configuration for myir YA157C
#@NEEDED_BSPLAYERS:

include conf/machine/include/myir-machine-common-stm32mp.inc
include conf/machine/include/myir-machine-providers-stm32mp.inc


MACHINEOVERRIDES .= ":stm32mp1common"
# =========================================================================
# Chip architecture
# =========================================================================
DEFAULTTUNE = "cortexa7thf-neon-vfpv4"
include conf/machine/include/tune-cortexa7.inc

# =========================================================================
# boot scheme
# =========================================================================
BOOTSCHEME_LABELS += "basic"
BOOTSCHEME_LABELS += "trusted"
#BOOTSCHEME_LABELS += "optee"

# =========================================================================
# boot device
# =========================================================================
# Define the boot device supported
BOOTDEVICE_LABELS += "emmc"
#BOOTDEVICE_LABELS += "nand-2-256"
#BOOTDEVICE_LABELS += "nor-nand-2-256"
BOOTDEVICE_LABELS += "sdcard"

# =========================================================================
# Machine settings
# =========================================================================
# Define list of devicetree per board
#STM32MP_DT_FILES_DK += "stm32mp157a-dk1"
#STM32MP_DT_FILES_DK += "stm32mp157c-dk2"
#STM32MP_DT_FILES_ED += "stm32mp157c-ed1"
#STM32MP_DT_FILES_EV += "stm32mp157c-ev1"
STM32MP_DT_FILES_YA157C += "stm32mp157c-ya157c-v2 stm32mp157c-ya157c-hdmi-v2 stm32mp157c-ya157c-lcd-v2"
# =========================================================================
# Machine features
# =========================================================================
MACHINE_FEATURES += "bluetooth"
MACHINE_FEATURES += "watchdog"
MACHINE_FEATURES += "wifi"
MACHINE_FEATURES += "${@'gpu' if d.getVar('ACCEPT_EULA_'+d.getVar('MACHINE')) == '1' else ''}"
# Splashscreen enabled
MACHINE_FEATURES += "splashscreen"
MACHINE_FEATURES += "m4copro"


# Bluetooth
BLUETOOTH_LIST += "linux-firmware-bluetooth-bcm4343"
# Wifi
WIFI_LIST += "linux-firmware-bcm43430"
# =========================================================================
# Image
# =========================================================================
# Add ubi FSTYPES to default ones for nand volumes
#IMAGE_FSTYPES += "stmultiubi"


# =========================================================================
# Kernel
# =========================================================================

# For eval board: auto-load goodix module (touchscreen module)
KERNEL_MODULE_AUTOLOAD = "edt-ft5x06"
#KERNEL_MODULE_AUTOLOAD += "goodix"
#KERNEL_MODULE_AUTOLOAD +="tsc2007"

# Define the devicetree for Linux A7 examples
#LINUX_A7_EXAMPLES_DT += "stm32mp157c-dk2-a7-examples"
#LINUX_A7_EXAMPLES_DT += "stm32mp157c-ev1-a7-examples"
#LINUX_A7_EXAMPLES_DT += "stm32mp157f-dk2-a7-examples"
#LINUX_A7_EXAMPLES_DT += "stm32mp157f-ev1-a7-examples"

# =========================================================================
# M4 copro
# =========================================================================
# Define the devicetree for M4 example
#CUBE_M4_EXAMPLES_DT += "stm32mp157c-dk2-m4-examples"
#CUBE_M4_EXAMPLES_DT += "stm32mp157c-ev1-m4-examples"
#CUBE_M4_EXAMPLES_DT += "stm32mp157f-dk2-m4-examples"
#CUBE_M4_EXAMPLES_DT += "stm32mp157f-ev1-m4-examples"

# Define specific board reference to use
#M4_BOARDS = "STM32MP157C-DK2"

# =========================================================================
# extlinux configuration
# =========================================================================
# As example, modify the default boot config to M4 config
#UBOOT_EXTLINUX_DEFAULT_LABEL_stm32mp157c-dk2 = "stm32mp157c-dk2-m4-examples"

# =========================================================================
# WIC for sdcard raw image
# =========================================================================
#WIC_CREATE_EXTRA_ARGS = "--no-fstab-update"
#WKS_FILE_DEPENDS ?= " \
#    virtual/bootloader \
#    virtual/trusted-firmware-a \
#    virtual/trusted-firmware-a-serialboot \
#    ${@bb.utils.contains('BOOTSCHEME_LABELS', 'optee', 'virtual/optee-os', '', d)} \
#    st-image-bootfs \
#    ${@bb.utils.contains('ST_VENDORFS','1','st-image-vendorfs', '', d)} \
#    st-image-userfs \
#"
#TRUSTED_WIC_FILE = "${@bb.utils.contains('ST_VENDORFS','1','sdcard-stm32mp157c-dk2-trusted-vendorfs-1GB.wks.in','sdcard-stm32mp157c-dk2-trusted-1GB.wks.in',d)}"
#OPTEE_WIC_FILE = "${@bb.utils.contains('ST_VENDORFS','1','sdcard-stm32mp157c-dk2-optee-vendorfs-1GB.wks.in','sdcard-stm32mp157c-dk2-optee-1GB.wks.in',d)}"

# for generated a WIC file, please uncomment the 2 following lines or add them to local.conf
#WKS_IMAGE_FSTYPES += "wic wic.bz2 wic.bmap"
#WKS_FILE += "${@bb.utils.contains('BOOTSCHEME_LABELS', 'optee', '${OPTEE_WIC_FILE}', '${TRUSTED_WIC_FILE}', d)}"
```
